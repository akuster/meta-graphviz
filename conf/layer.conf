## conf/layer.conf
```bitbake
# We have a conf and classes directory, add to BBPATH
BBPATH .= ":${LAYERDIR}"

# We have recipes-* directories, add to BBFILES
BBFILES += "${LAYERDIR}/recipes-*/*/*.bb \
	${LAYERDIR}/recipes-*/*/*.bbappend"

BBFILE_COLLECTIONS += "graphviz"
BBFILE_PATTERN_graphviz = "^${LAYERDIR}/"
BBFILE_PRIORITY_graphviz = "6"

# layer depends
LAYERDEPENDS_graphviz = "core"
LAYERDEPENDS_graphviz += "openembedded-layer"
```
